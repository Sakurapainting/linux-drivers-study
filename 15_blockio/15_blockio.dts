/ {
    key {
		compatible = "alientek,key";
		pinctrl-names = "default";
		pinctrl-0 = <&pinctrl_key>;
		key-gpios = <&gpio1 18 GPIO_ACTIVE_LOW>;
		status = "okay";
	};
};

&iomuxc {
    pinctrl_key: keygrp{
        fsl,pins = <
            MX6UL_PAD_UART1_CTS_B__GPIO1_IO18	0xF080
        >;
    };
};