&iomuxc {
    /*you PWM3*/
    pinctrl_pwm3: pwm3grp {
        fsl,pins = <
            MX6UL_PAD_GPIO1_IO04__PWM3_OUT 0x110b0
        >;
    };    
};

/*you pwm3*/
&pwm3 {
	pinctrl-names = "default";
	pinctrl-0 = <&pinctrl_pwm3>;
	clocks = <&clks IMX6UL_CLK_PWM3>,
	        <&clks IMX6UL_CLK_PWM3>;
	status = "okay";
};